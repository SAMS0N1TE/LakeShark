## bench/mixrf_probe/sdkconfig.defaults
```kconfig
CONFIG_IDF_TARGET="esp32p4"
CONFIG_ESP32P4_SELECTS_REV_LESS_V3=y
CONFIG_ESP32P4_REV_MIN_1=y
CONFIG_ESPTOOLPY_FLASHSIZE_16MB=y
CONFIG_ESPTOOLPY_FLASHMODE_DIO=y
CONFIG_FREERTOS_HZ=1000
CONFIG_ESP_MAIN_TASK_STACK_SIZE=8192
CONFIG_CPP_BUS_DRIVER_LOG_LEVEL_INFO=y
```

## components/chmorgan__esp-audio-player/Kconfig
```kconfig
menu "Audio playback"

    config AUDIO_PLAYER_ENABLE_WAV
        bool "Enable wav file playback"
        default y
        help
            Audio player can decode wave files.

    config AUDIO_PLAYER_LOG_LEVEL
        int "Audio Player log level (0 none - 3 highest)"
        default 0
        range 0 3
        help
            Specify the verbosity of Audio Player log output.
endmenu
```

## main/Kconfig.projbuild
```kconfig
menu "LakeShark"
    config LS_LAP_3D
        bool "Native app 3D renderer"
        default y
        help
            Export the lap3d renderer to native apps (about 66 KiB of code
            plus shared tables). When disabled, apps importing l3_* are
            rejected by the loader with a missing-symbol error. Other native
            apps and the firmware map renderer remain available.

    config LS_MUSIC_COMPRESSED
        bool "MP3, FLAC and Ogg Vorbis playback"
        default y
        help
            Include compressed music decoders (about 91 KiB of code plus
            shared tables). WAV playback, recording and SDK PCM audio do not
            need this option. Compressed files fail to open when disabled.

    config LS_LAP_SERVICES_MAX
        int "Maximum resident native app services"
        range 1 4
        default 2 if LS_BOARD_P4_NANO
        default 3
        help
            Bounded resident service slots, plus one foreground app. Each slot
            has separate resource tables, a 4 MiB app heap and a 4 ms tick.
    choice LS_BOARD
        prompt "LakeShark target board"
        default LS_BOARD_P4_NANO
        help
            Selects the board profile in components/lakeshark/board/.
            Everything the boards share (I2C, I2S, PA enable, uSD, the SDIO link
            to the on-board ESP32-C6) is identical across the Waveshare ESP32-P4
            family; this choice covers what actually differs - USB VBUS control,
            the display, and which header pins the Flipper link can use.

        config LS_BOARD_P4_NANO
            bool "Waveshare ESP32-P4-NANO (16MB)"

        config LS_BOARD_P4_WIFI6
            bool "Waveshare ESP32-P4-WIFI6 (32MB, no LCD)"

        config LS_BOARD_P4_TOUCH_LCD_4B
            bool "Waveshare ESP32-P4-WIFI6-Touch-LCD-4B / Smart 86 Box (32MB)"

        config LS_BOARD_P4_TOUCH_LCD_43
            bool "Waveshare ESP32-P4-WIFI6-Touch-LCD-4.3 (32MB)"

        config LS_BOARD_T_DISPLAY_P4
            bool "LilyGO T-Display-P4 (16MB)"
            help
                AMOLED display and peripherals defined by the T-Display-P4
                board profile in components/lakeshark/board/variants/.
    endchoice

    choice LS_TDP4_PANEL
        prompt "T-Display-P4 display SKU"
        depends on LS_BOARD_T_DISPLAY_P4
        default LS_TDP4_PANEL_RM69A10
        help
            The T-Display-P4 ships with one of two MIPI-DSI panels. They differ
            in resolution, timings, brightness control and touch controller,
            so the image must be built for the one fitted.

        config LS_TDP4_PANEL_RM69A10
            bool "4.1\" AMOLED, RM69A10 568x1232, GT9895 touch"

        config LS_TDP4_PANEL_HI8561
            bool "TFT, HI8561 540x1168, HI8561 touch, PT4103 backlight"
    endchoice

    config LS_LR2021_ONLY
        bool "LakeShark LR: LR2021 boards only, no USB dongles or SX1262"
        depends on LS_BOARD_T_DISPLAY_P4
        default n
        help
            Builds the LR edition for the T-Display-P4 LR2021 variant. Leaves
            out the USB host stack, the RTL-SDR and HackRF drivers, the SX1262
            driver and the apps that need a dongle (CELL, CATCH, ACARS), and
            spends the memory on the LR2021. The image refuses SX1262 boards.

    config LS_SD_MAX_FREQ_KHZ
        int "SD card maximum clock (kHz)"
        range 20000 40000
        default 40000 if LS_BOARD_T_DISPLAY_P4
        default 20000
        help
            T-Display-P4 supports 3.3 V high-speed SDR on slot 0. Mount
            initialization or verification failures retry at 20 MHz.
            Set 20000 to force the original clock. No UHS voltage switch.

    config LS_PANEL_RUNTIME
        bool "Waveshare DSI panel chosen at runtime ('panel' command)"
        depends on LS_BOARD_P4_NANO && LAKESHARK_HEADLESS
        default n
        help
            Builds in the TUI and a driver for Waveshare's MIPI-DSI panels on
            the board's DSI connector. Nothing changes until a panel is saved
            with 'panel set <name>'; with none the board stays headless.

    config LS_TX_UNLOCKED
        bool "Experimental: no software TX limits (lab testing)"
        default n
        help
            Removes every software transmit limit: band and region checks,
            power caps, time-on-air, duty and heat budgets, and edge and
            duration caps on replay. What is left is what the hardware
            itself cannot do: a chip's own register range, the PA path it
            has, and buffer sizes. Never enable in a release build.

    config LS_NANO_RAM_BUDGET
        bool "Nano desktop internal RAM budget"
        depends on LS_BOARD_P4_NANO && LS_PANEL_RUNTIME && SPIRAM
        depends on FREERTOS_TASK_CREATE_ALLOW_EXT_MEM && SPIRAM_ALLOW_BSS_SEG_EXTERNAL_MEMORY
        default n
        help
            Keep flash-writing workers in DRAM; put the read-only BLE
            telemetry, advertisement and UI stall monitor stacks in PSRAM.
            Right-size measured desktop workers to leave room for EMAC DMA.

    config LS_NANO_ETH
        bool "Nano wired Ethernet (IP101GRI)"
        depends on LS_BOARD_P4_NANO && LS_PANEL_RUNTIME
        select ETH_USE_ESP32_EMAC
        default y
        help
            Starts the P4 EMAC with DHCP alongside the C5 Wi-Fi netif.
            Does not enable a listener: use 'term web on' explicitly.
            'eth off' persists across reboots; 'eth on' restores it.

    config LS_VBUS_EN_GPIO
        int "USB host VBUS enable GPIO (-1 if the port is hard-powered)"
        default 46 if LS_BOARD_P4_NANO
        default 46 if LS_BOARD_P4_WIFI6
        default -1 if LS_BOARD_P4_TOUCH_LCD_4B
        default -1 if LS_BOARD_P4_TOUCH_LCD_43
        default -1
        help
            GPIO driving the load switch that feeds VBUS on the USB host port.
            The firmware drops it to force an unresponsive RTL-SDR to
            re-enumerate ('SDR power', and the automatic stall recovery).

            Set to -1 if the host port is powered directly. On a board with no
            switch the power cycle is skipped rather than driving an unrelated
            pin, and the console says so.

            GPIO46 is confirmed on the ESP32-P4-NANO. It is the assumed default
            on the ESP32-P4-WIFI6 as well because the rest of that board's
            peripheral wiring matches the NANO exactly, but it has not been
            confirmed against hardware - note that GPIO46 is also broken out on
            the pin header of both boards, so the header alone does not settle
            it.

    config LS_DEFAULT_VOLUME
        int "Default audio volume (0-100)"
        range 0 100
        default 50
        help
            Volume used when NVS has no saved value yet - i.e. a fresh board, or
            after an NVS erase. Applied before the boot chime plays.

            Once you change the volume at runtime it is saved to NVS after ~1.5 s
            and that saved value wins on every later boot, so this only governs
            first boot.

    config LS_LAP_HACKRF_TX
        bool "Native app HackRF transmit backend"
        default y
        help
            Bounded USB IQ transmit with cancellation and power accounting.
            Off retains HackRF reception and all SDK symbols; TX reports
            unsupported and lap_caps clears the HackRF radio_tx bit.

    config LS_LAP_WORKER_DSP
        bool "Native app worker DSP callbacks"
        default y
        help
            Preemptible app-defined IQ processing on a private worker. Off
            keeps receive channels, spectrum and built-in decoder attachment.
            DSP calls report unsupported; lap_caps omits LAP_HW_WORKER_DSP.

    config LS_LAP_NFC
        bool "Native app NFC service"
        default y
        help
            Copied tag events and NDEF writes through the NFC backend. Off
            retains SDK symbols and the built-in NFC tools, reports unsupported
            and clears LAP_HW_NFC and LAP_HW_NDEF_WRITE in lap_caps.

    config LS_LAP_MDNS
        bool "Native app mDNS browse and registration"
        default y
        help
            Native app DNS-SD discovery and registration. Off keeps Wi-Fi,
            HTTPS, UDP and time, returns unsupported and omits LAP_HW_MDNS.
            The network terminal's existing responder remains available.

    # API 2.6: Bluetooth peripheral roles; board profiles may opt out.
    config LS_LAP_BLE_ADVERTISER
        bool "Native app BLE advertising"
        depends on LS_BLE_HEAD && BT_NIMBLE_EXT_ADV
        select BT_NIMBLE_ROLE_BROADCASTER
        default y
        help
            Exclusive peripheral lease; 31-byte legacy PDUs through extended
            HCI commands (per-advertiser bounded TX power). No extra task.
            See app-sdk/docs/BLE_PERIPHERAL.md for RAM/admission estimates.

    config LS_LAP_GATT_SERVER
        bool "Native app GATT server"
        depends on LS_LAP_BLE_ADVERTISER
        select BT_NIMBLE_ROLE_PERIPHERAL
        select BT_NIMBLE_GATT_SERVER
        default y
        help
            Optional 16-attribute copied database, one peer, MTU-independent
            20-byte notifications. No increase to NimBLE connection pools.

    config LS_LAP_HID_DEVICE
        bool "Native app BLE keyboard/mouse/gamepad peripheral"
        depends on LS_LAP_GATT_SERVER && BT_NIMBLE_SECURITY_ENABLE && BT_NIMBLE_NVS_PERSIST
        depends on BT_NIMBLE_SM_SC || BT_NIMBLE_SM_LEGACY
        default y
        help
            Standard HOGP report maps using the same GATT server allocation.
            Requires manifest HID_DEVICE and RADIO_TX. Keys stay in NimBLE NVS.

    config LS_BLE_HEAD
        bool "BLE control head (Flipper / host over BLE)"
        depends on BT_ENABLED && BT_NIMBLE_ENABLED
        default y
        help
            Build the BLE control head: LakeShark scans for a Flipper running
            the LakeShark app and connects out to it, carrying the same
            command set as the UART head.

            Turn this OFF if you only ever use the UART head or the serial
            console. The BLE link and the whole NimBLE stack drop out of the
            build, which is a large flash and RAM saving on a board that will
            never use it.

            The `ble` console commands still exist with this off - they report
            that the build has no radio head rather than disappearing, so a
            missing command never looks like a firmware fault. The UART head
            is unaffected either way: flipper_link.c is the command parser for
            both transports and is always built.

            This depends on BT_ENABLED, so clearing CONFIG_BT_ENABLED turns it
            off on its own. To drop BLE entirely, clear both - see
            boards/nano_headless_nobt.defaults for a worked example.

    config LAKESHARK_HEADLESS
        bool
        default y
        help
            Every board boots into the radio backend and the console; a board
            with a panel draws the character-grid UI on top of it.

    config LS_C6_LINK
        bool "Bring up the ESP32-C6 co-processor at boot"
        default y
        help
            Attempt esp_hosted_connect_to_slave() during startup.

            Requires compatible ESP-Hosted firmware on the ESP32-C6.
            Disable when the co-processor uses a different protocol.

    config LS_RTERM_WEB
        bool "Web screen (the board's screen in a browser over WiFi)"
        default y
        help
            'term web on' serves a page on port 80 with the screen and its keys
            (about 80 KB of page, scripts and icons). Off, the USB screen feed and
            telnet still work; the T-Display builds turn it off for app space.

    config LS_SSH
        bool "SSH for the network terminal"
        default y
        help
            'term ssh on' serves the screen over SSH (libssh, about 230 KB).
            Off, telnet and the web screen still work; the T-Display builds
            turn it off to fit their app slot.

    config EXAMPLE_ENABLE_SD_CARD
        bool "Enable SD Card"
        default n
        help
            Enabling this option will initialize the SD card, so the SD card needs to be inserted into the slot. Additionally, if using the Video Player example, an MJPEG format video must be saved on the SD card.
endmenu

config LS_RX_HEAD
    bool "RADIO: one receiver head with decoder plugins (preview)"
    default n
    help
        Register the RADIO screen: FM's receiver as the RX HEAD, its decoders
        as plugins with their own panels, the shared rail, waterfall strip and
        deck. FM keeps its own screen either way.

config LS_EXAMPLE_APP
    bool "Show native framework example app"
    default n
    help
        Build and register the small shared-widget tap counter example.

# esp_hosted 3.1.0 (registry, 2026-11-05) gates its USB dependencies on
# these options, compared with 1. esp_wifi_remote accepts any esp_hosted,
# so when the component manager fetches esp_hosted's versions it reads
# 3.1.0's rules, finds the options in no Kconfig and stops the build
# ("Missing required kconfig option after retry"), although
# main/idf_component.yml pins 2.12.9. Defined here as 0, the rules are
# false. Remove them when moving to esp_hosted 3.x, which defines its own.
menu "esp_hosted 3.x dependency switches (unused with 2.12.9)"
    config ESP_HOSTED_HOST_USB_CDC_ACM_MANIFEST
        int "esp_hosted 3.x: pull in usb_host_cdc_acm"
        default 0
    config ESP_HOSTED_HOST_USB_CHERRYUSB_MANIFEST
        int "esp_hosted 3.x: pull in cherryusb"
        default 0
    config ESP_HOSTED_HOST_USB_RNDIS_MANIFEST
        int "esp_hosted 3.x: pull in iot_usbh_rndis"
        default 0
    config ESP_HOSTED_CP_TINYUSB_MANIFEST
        int "esp_hosted 3.x: pull in esp_tinyusb"
        default 0
endmenu
```
