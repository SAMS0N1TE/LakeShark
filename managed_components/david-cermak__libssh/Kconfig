## managed_components/david-cermak__libssh/Kconfig
```kconfig
menu "libssh"

    config LIBSSH_SNTRUP761
        bool "Enable SNTRUP761 (post-quantum) key exchange"
        default n
        help
            Enable the sntrup761x25519-sha512 hybrid key exchange
            algorithm. This adds significant stack usage due to the
            SNTRUP761 cryptographic operations. Disable to reduce the
            memory footprint on constrained devices.

    config LIBSSH_MLKEM
        bool "Enable ML-KEM (post-quantum) key exchange"
        default n
        help
            Enable ML-KEM (Module-Lattice-based Key Exchange Mechanism)
            hybrid key exchange algorithms: mlkem768x25519-sha256 and
            mlkem768nistp256-sha256.

            The ML-KEM implementation adds significant code size (~80 KB)
            and stack usage (~40 KB) due to the libcrux cryptographic
            library. Disable to reduce the memory footprint on
            constrained devices.

endmenu
```

## managed_components/david-cermak__libssh/examples/bastion/sdkconfig.defaults
```kconfig
CONFIG_PARTITION_TABLE_SINGLE_APP_LARGE=y
CONFIG_EXAMPLE_CONNECT_IPV6=n
CONFIG_ETHERNET_PHY_INTERFACE_RMII=y
CONFIG_ETHERNET_PHY_KSZ80XX=y
CONFIG_ESP_SYSTEM_PANIC_PRINT_HALT=y
CONFIG_ESP_MAIN_TASK_STACK_SIZE=8192
CONFIG_LWIP_IP_FORWARD=y
CONFIG_LWIP_IPV4_NAPT=y
CONFIG_MBEDTLS_THREADING_C=y
CONFIG_MBEDTLS_THREADING_ALT=n
CONFIG_MBEDTLS_THREADING_PTHREAD=y
CONFIG_LWIP_NETIF_API=y         # To support build on IDFv5.3
```

## managed_components/david-cermak__libssh/examples/server/main/Kconfig.projbuild
```kconfig
menu "SSH Server Example Configuration"

    config EXAMPLE_DEFAULT_PORT
        string "SSH server port"
        default "2222"
        help
            TCP port the SSH server binds to.

    config EXAMPLE_DEBUG_LEVEL
        string "Log verbosity (1-4)"
        default "1"
        help
            libssh log verbosity level as a string. Increase for more verbose logs.

    config EXAMPLE_ALLOW_PASSWORD_AUTH
        bool "Enable password authentication"
        default n
        help
            Allow SSH password authentication.

    config EXAMPLE_ALLOW_PUBLICKEY_AUTH
        bool "Enable public-key authentication"
        default y
        help
            Allow SSH public-key authentication.

    config EXAMPLE_DEFAULT_USERNAME
        string "Default username"
        default "user"
        help
            Username required by the example server.

    config EXAMPLE_DEFAULT_PASSWORD
        string "Default password"
        depends on EXAMPLE_ALLOW_PASSWORD_AUTH
        default "password"
        help
            Password for the default user (only used if password auth is enabled).

endmenu
```
