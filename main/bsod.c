
#include "bsod.h"
#include <stdint.h>
#include <stddef.h>
#include "esp_attr.h"
#include "esp_lcd_mipi_dsi.h"

typedef struct {
    int core;
    const char *reason;
    const void *pc;
    bool backtrace_corrupt;
    bool backtrace_continues;
    unsigned int backtrace_len;
    unsigned int backtrace[60];
} arduino_panic_info_t;
typedef void (*arduino_panic_handler_t)(arduino_panic_info_t *info, void *arg);
extern void set_arduino_panic_handler(arduino_panic_handler_t handler, void *arg);

#define BSOD_W   720
#define BSOD_H   720
#define BSOD_MAX_FB 3

#define COL_BG   0x03DA
#define COL_FG   0xFFFF
#define COL_DIM  0x9CF3

static void    *s_fb[BSOD_MAX_FB];
static int      s_fb_count;

static const uint8_t DRAM_ATTR s_font[96][8] = {
 {0,0,0,0,0,0,0,0},
 {0x18,0x3C,0x3C,0x18,0x18,0x00,0x18,0x00},
 {0x36,0x36,0x00,0x00,0x00,0x00,0x00,0x00},
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 {0,0,0,0,0,0,0,0},
};

static void bsod_panic_cb(arduino_panic_info_t *info, void *arg);

void bsod_init(esp_lcd_panel_handle_t dsi_panel)
{
    if (!dsi_panel) return;
    void *f0 = NULL, *f1 = NULL, *f2 = NULL;

    if (esp_lcd_dpi_panel_get_frame_buffer(dsi_panel, 3, &f0, &f1, &f2) == ESP_OK) {
        s_fb[0] = f0; s_fb[1] = f1; s_fb[2] = f2; s_fb_count = 3;
    } else if (esp_lcd_dpi_panel_get_frame_buffer(dsi_panel, 2, &f0, &f1) == ESP_OK) {
        s_fb[0] = f0; s_fb[1] = f1; s_fb_count = 2;
    } else if (esp_lcd_dpi_panel_get_frame_buffer(dsi_panel, 1, &f0) == ESP_OK) {
        s_fb[0] = f0; s_fb_count = 1;
    }

    (void)bsod_panic_cb;
}

static inline void IRAM_ATTR px(uint16_t *fb, int x, int y, uint16_t c)
{
    if ((unsigned)x < BSOD_W && (unsigned)y < BSOD_H) fb[y * BSOD_W + x] = c;
}

static void IRAM_ATTR fill(uint16_t *fb, uint16_t c)
{
    for (int i = 0; i < BSOD_W * BSOD_H; i++) fb[i] = c;
}

static void IRAM_ATTR glyph(uint16_t *fb, int x, int y, char ch, uint16_t c, int s)
{
    if (ch < 0x20 || ch > 0x7F) ch = '?';
    const uint8_t *g = s_font[(int)ch - 0x20];
    for (int row = 0; row < 8; row++) {
        uint8_t bits = g[row];
        for (int col = 0; col < 8; col++) {
            if (bits & (1u << col)) {
                for (int dy = 0; dy < s; dy++)
                    for (int dx = 0; dx < s; dx++)
                        px(fb, x + col * s + dx, y + row * s + dy, c);
            }
        }
    }
}

static int IRAM_ATTR text(uint16_t *fb, int x, int y, const char *str, uint16_t c, int s)
{
    while (str && *str) { glyph(fb, x, y, *str++, c, s); x += 8 * s; }
    return x;
}

static void IRAM_ATTR hex32(uint32_t v, char *out)
{
    static const char DRAM_ATTR H[] = "0123456789ABCDEF";
    out[0] = '0'; out[1] = 'x';
    for (int i = 0; i < 8; i++) out[2 + i] = H[(v >> ((7 - i) * 4)) & 0xF];
    out[10] = 0;
}

static void IRAM_ATTR bsod_paint(const arduino_panic_info_t *info)
{
    if (s_fb_count == 0) return;

    const char *reason = info ? info->reason : NULL;
    uint32_t    pc     = info ? (uint32_t)(uintptr_t)info->pc : 0;
    int         core   = info ? info->core : 0;
    char hx[12];

    for (int b = 0; b < s_fb_count; b++) {
        uint16_t *fb = (uint16_t *)s_fb[b];
        if (!fb) continue;
        fill(fb, COL_BG);

        int x = 150;
        int y = 140;
        glyph(fb, x, y, ':', COL_FG, 10);
        glyph(fb, x + 70, y, '(', COL_FG, 10);
        y += 120;

        text(fb, x, y, "Your LakeShark ran into a problem", COL_FG, 3); y += 40;
        text(fb, x, y, "and needs to restart.", COL_FG, 3);             y += 60;

        if (reason) { int xx = text(fb, x, y, "Stop:  ", COL_FG, 2); text(fb, xx, y, reason, COL_FG, 2); y += 26; }

        hex32(pc, hx);
        int xx = text(fb, x, y, "PC:    ", COL_FG, 2);
        xx = text(fb, xx, y, hx, COL_FG, 2);
        xx = text(fb, xx, y, "   Core ", COL_FG, 2);
        char cc[2] = { (char)('0' + (core & 1)), 0 };
        text(fb, xx, y, cc, COL_FG, 2);
        y += 34;

        if (info && info->backtrace_len > 1) {
            int shown = 0;
            xx = text(fb, x, y, "BT:    ", COL_DIM, 2);
            for (unsigned i = 1; i < info->backtrace_len && shown < 4; i++, shown++) {
                hex32(info->backtrace[i], hx);
                xx = text(fb, xx, y, hx + 2, COL_DIM, 2);
                xx = text(fb, xx, y, " ", COL_DIM, 2);
            }
            y += 34;
        }
        y += 22;

        text(fb, x, y, "Serial @115200 has the full backtrace.", COL_DIM, 2);
    }
}

static void IRAM_ATTR bsod_panic_cb(arduino_panic_info_t *info, void *arg)
{
    (void)arg;
    bsod_paint(info);
}
